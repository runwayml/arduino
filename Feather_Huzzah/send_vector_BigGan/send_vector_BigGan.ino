// wifi lib
#include <ESP8266WiFi.h>
#include <ESP8266WiFiMulti.h>
#include <ESP8266HTTPClient.h>
#include <WiFiClient.h>
// json lib
#include <ArduinoJson.h>

// wifi settings
ESP8266WiFiMulti WiFiMulti;
const char* ssid = "put-your-wifi-ssid-here";
const char* pass = "put-your-wifi-password-here";
const char* host = "http://192.168.8.102:8000/query";

// two vectors exported from runway used as bounds for the interpolation
float  vector1 [] = { 0.2273744317223756,-0.8174532165457828,0.35366239427218665,-0.17851218639521174,-0.12692330404852248,0.015140817695536546,0.23020203208886433,0.12565617574122678,0.2872844233718924,-0.20789916976978326,0.2836953268745391,-0.0008530931978214668,-0.14706951796862866,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0.10754263306469991,0.45162213416743885};
float  vector2 [] = {-0.02266391556201476,-0.35962981439107755,0.8903013916859396,-0.29373156898411135,0.176795000843825,0.29448834614894215,-0.6144914839331969,-0.7877140512959753,-0.4119900245248429,0.013310226505644368,0.22132776635356477,0.24305205813887795,-0.7498898008837013,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1.3334647581516244,0.10555608829202856};


void setup() {
  Serial.begin(115200);
  delay(100);
  wifi_connect();
}

void loop() {

  // read data from analog 17 (eg A0)
  Serial.println(analogRead(17));

  // Use arduinojson.org/assistant to compute the capacity.
  const size_t capacity = JSON_ARRAY_SIZE(140) + JSON_OBJECT_SIZE(2);
  DynamicJsonDocument doc(capacity);
  // Add data to it with the input specifications from runway's network tab
  // Add data to it : key == "category" / content == category from available categories in bigGan (no maj)
  doc["category"] = "bubble";
  // Add a nested array with the key "z" for the computed vector
  JsonArray z = doc.createNestedArray("z");

  for (int i = 0; i < 140; i++) {
    float v1 = analogRead(17) / 350.0; // normalize reading
    float v2 = (1 - v1); // inverse it
    z.add( (vector1[i] * v1 + vector2[i] * v2) / 2 ); // compute the mean and add it to our array
  }

  serializeJson(doc, Serial); // print json to serial output

  // write data to a string with json formatting
  String json;
  serializeJson(doc, json);
  http_post(json); // post it !

  delay(400); // this delay is approximatively the compute time of the model in remote

}



void wifi_connect() {
  Serial.println();
  Serial.println();
  Serial.println();
  WiFi.mode(WIFI_STA);
  WiFiMulti.addAP(ssid, pass);
  for (uint8_t t = 4; t > 0; t--) {
    Serial.printf("[SETUP] WAIT %d...\n", t);
    Serial.flush();
    delay(1000);
  }
  delay(1000);
  Serial.print("connected : ");
  Serial.println(WiFiMulti.run() == WL_CONNECTED );
}

void http_post(String content) {
  // wait for WiFi connection
  if ((WiFiMulti.run() == WL_CONNECTED)) {
    WiFiClient client;
    HTTPClient http;
    Serial.print("[HTTP] begin...\n");
    if (http.begin(client, host)) {  // HTTP withe the route defined by runway
      // post to http
      http.addHeader("Content-Type", "application/json");
      int httpCode = http.POST(content);
      // handle response
      // httpCode will be negative on error
      if (httpCode > 0) {
        // HTTP header has been send and Server response header has been handled
        Serial.printf("[HTTP] POST... code: %d\n", httpCode);
        // file found at server
        if (httpCode == HTTP_CODE_OK) {
        }
      } else {
        Serial.printf("[HTTP] POST... failed, error: %s\n", http.errorToString(httpCode).c_str());
      }
      // close
      http.end();
    }
  }

}
